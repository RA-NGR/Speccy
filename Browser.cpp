#include "Browser.h"

uint8_t fontData[] = { // 8x8 Spectrum font with russian characters, codepage Windows-1251
	0x00, 0x00, 0x00, 0x00, 0x00, 0x00, 0x00, 0x00,
	0x00, 0x10, 0x10, 0x10, 0x10, 0x00, 0x10, 0x00, // !
	0x00, 0x24, 0x24, 0x00, 0x00, 0x00, 0x00, 0x00, // "
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	0x00, 0x00, 0x3C, 0x44, 0x3C, 0x24, 0x44, 0x00  // я
};

void Browser::drawChar(const uint8_t ch, uint8_t posX, uint16_t foreColor, uint16_t backColor)
{
	uint16_t* pBuffer = m_pDisplayInstance->getBuffer(0);
	if (ch < 32 || posX > 39) return;
	uint16_t glyphPos = (uint16_t)(ch - 32) * 8;
	for (int j = 0; j < 8; j++)
	{
		uint8_t glyphByte = fontData[glyphPos + j];
		for (int i = 0; i < 8; i++)
		{
			if (glyphByte & 0x80)
				pBuffer[j * 320 + i + posX * 8] = foreColor;
			else
				pBuffer[j * 320 + i + posX * 8] = backColor;
			glyphByte <<= 1;
		}
	}
}

void Browser::drawString(const String textStr, uint8_t posX, uint8_t posY, uint16_t foreColor, uint16_t backColor, bool isAnsi)
{
	String decodedStr = textStr;
	if (!isAnsi) decodedStr = utf8rus(textStr);
	if (posY > 29) return;
	m_pDisplayInstance->setAddrWindow(0, posY * 8, 319, posY * 8 + 7);
	int idx = 0;
	while (decodedStr[idx])
	{
		drawChar(decodedStr[idx], posX + idx, foreColor, backColor); idx++;
	}
	m_pDisplayInstance->drawBuffer(0, 320 * 8);
}

String Browser::utf8rus(String source)
{
	int idx = 0, len = source.length();
	String res;
	uint8_t ch;
	char decodedChar[2] = { ' ', '\0' };
	while (idx < len) 
	{
		ch = source[idx]; idx++;
		if (ch >= 0xC0) 
		{
			switch (ch) 
			{
			case 0xD0:
				ch = source[idx]; idx++;
				if (ch == 0x81) 
					ch = 0xA8;
				else
					if (ch >= 0x90 && ch <= 0xBF) ch = ch + 0x30;
				break;
			case 0xD1:
				ch = source[idx]; idx++;
				if (ch == 0x91)
					ch = 0xB8;
				else
					if (ch >= 0x80 && ch <= 0x8F) ch = ch + 0x70;
				break;
			}
		}
		decodedChar[0] = ch; res = res + String(decodedChar);
	}
	return res;
}

void Browser::countFiles()
{
	m_filesCount = 0;
	File dirFile = SD.open(m_currDir), entry;
	if (!dirFile) return;
	dirFile.rewindDirectory();
	while (entry = dirFile.openNextFile())
	{
		m_filesCount++; entry.close();
	}
	dirFile.close();
}

void Browser::listFiles()
{
	drawString("                                        ", 0, 0, 0xFFFF, 0x1700);
	for (int i = 0; i < 21; i++)
	{
		String outStr = " ";
		outStr += m_browserWindow[i];
		if (outStr.length() > 38)
		{
			String tmp = outStr;
			tmp.toLowerCase();
			int pos = tmp.lastIndexOf(".tap");
			outStr.remove(33, pos - 33);
			outStr.setCharAt(32, '~');
		}
		for (int j = outStr.length(); j < 38; j++) outStr += " ";
		uint16_t backColor = 0x1700, foreColor = 0xF7BD;
		if (m_currDir + m_browserWindow[i] == m_selectedFile) foreColor = 0xE0FF;
		if (outStr[1] == '/') foreColor = 0xFF07;
		if (i + 1 == m_selectionPos)
		{
			backColor = 0xFF07; foreColor = 0x0000;
		}
		drawString(outStr, 1, i + 1, foreColor, backColor);
		drawString("                                        ", 0, 22, 0xFFFF, 0x1700);
	}
}

void Browser::chDir()
{
	countFiles();
	m_browseFrom = m_selectionPos = 1;
	dir();
}

void Browser::dir()
{
	for (int i = 0; i < 21; i++) m_browserWindow[i] = "";
	File dirFile = SD.open(m_currDir), entry;
	if (!dirFile) return;
	int count = 0;
	dirFile.rewindDirectory();
	if (m_currDir != "/" && dirFile.isDirectory())
	{
		m_browserWindow[0] = "/.."; count++;
	}
	while (entry = dirFile.openNextFile())
	{
		String fileName = "";
		count++;
		if (count >= m_browseFrom)
		{
			if (entry.isDirectory()) fileName += "/";
			fileName += entry.name();
			m_browserWindow[count - m_browseFrom] = fileName;
		}
		entry.close();
		if (count - m_browseFrom >= 20) break;
	}
	dirFile.close();
}

void Browser::drawSettingsString()
{
	String settingString = "  Звук: ";
	settingString += (m_soundOn ? "ВКЛ " : "ВЫКЛ");
	settingString += "                 Лента: ";
	settingString += (m_tapeTurbo ? "2Х  " : "1Х  ");
	drawString(settingString, 0, 25, 0xF7BD, 0x1700, false);
}

void Browser::drawSelectedROM() 
{
	String romString = "  ROM : ";
	romString += m_romFileNames[m_currRom];
	for (int i = romString.length(); i < 38; i++) romString += " ";
	drawString(romString, 0, 26, 0xF7BD, 0x1700);
}

void Browser::drawFooter()
{
	drawString("----------------------------------------", 0, 23, 0xF7BD, 0x1700);
	drawString("                                        ", 0, 24, 0xFFFF, 0x1700);
	drawSettingsString();
	drawSelectedROM();
	drawString("                                        ", 0, 27, 0xFFFF, 0x1700);
	drawString(" F1-Спр F2-Звук F3-Лента F4-ROM  F5-Вых ", 0, 28, 0xE0FF, 0x1700, false);
	drawString("                                        ", 0, 29, 0xFFFF, 0x1700);
}

bool Browser::run()
{
	bool result = false;
	if (!(SD.begin(SS, SPI_FULL_SPEED))) return result;
	chDir();
	listFiles();
	drawFooter();
	while (true)
	{
		if (m_pKeyboardInstance->getData(9) == 0x01)
		{
			LittleFS.begin();
			File helpFile = LittleFS.open("/Help.txt", "r");
			for (int i = 0; i < 26; i++)
			{
				char strData[43];
				helpFile.readBytes(strData, 42);
				strData[40] = 0;
				drawString(strData, 0, i + 2, 0x0000, 0xF7BD);
			}
			helpFile.close();
			LittleFS.end();
			delay(500);
			while (m_pKeyboardInstance->getData(9) != 0x01) yield();
			listFiles();
			drawFooter();
			delay(500);
		}
		if (m_pKeyboardInstance->getData(9) == 0x02)
		{
			m_soundOn ^= true;
			drawSettingsString();
			delay(500);
		}
		if (m_pKeyboardInstance->getData(9) == 0x04)
		{
			m_tapeTurbo ^= true;
			drawSettingsString();
			delay(500);
		}
		if (m_pKeyboardInstance->getData(9) == 0x08)
		{
			m_currRom = (m_currRom + 1) & 0x03;
			drawSelectedROM();
			result = true;
			delay(500);
		}
		if (m_pKeyboardInstance->getData(9) == 0x10) break;
		if (m_pKeyboardInstance->getData(8) == 0x04)
		{
			m_selectionPos++;
			if (m_selectionPos > 21 || m_browserWindow[m_selectionPos - 1] == "")
			{
				m_selectionPos--;
				if (m_browseFrom + 19 < m_filesCount)
				{
					m_browseFrom++; dir();
				}
			}
			else
				delay(150);
			listFiles();
		}
		if (m_pKeyboardInstance->getData(8) == 0x08)
		{
			m_selectionPos--;
			if (m_selectionPos == 0)
			{
				m_selectionPos++;
				if (m_browseFrom > 1)
				{
					m_browseFrom--; dir();
				}
			}
			else
				delay(150);
			listFiles();
		}
		if (m_pKeyboardInstance->getData(8) == 0x10)
		{
			if (m_browserWindow[m_selectionPos - 1][0] == '/')
			{
				if (m_browserWindow[m_selectionPos - 1] == "/..")
				{
					m_currDir.remove(m_currDir.length() - 1);
					m_currDir.remove(m_currDir.lastIndexOf("/") + 1);
				}
				else
				{
					m_currDir.remove(m_currDir.length() - 1);
					m_currDir += m_browserWindow[m_selectionPos - 1];
					m_currDir += "/";
				}
				chDir();
				listFiles();
			}
			else
			{
				m_selectedFile = m_currDir + m_browserWindow[m_selectionPos - 1];
				listFiles();
			}
			delay(500);
		}
		yield();
	}
	SD.end();
	return result;
}